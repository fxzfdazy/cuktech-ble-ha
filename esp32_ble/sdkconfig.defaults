## esp32_ble/sdkconfig.defaults.esp32c3
```kconfig
# ESP32-C3 overrides (single core)
CONFIG_BT_NIMBLE_PINNED_TO_CORE=-1
# Disable 4.1 compat — C3 is BLE 5.0
# CONFIG_BT_NIMBLE_4_1_COMPAT is not set

# NimBLE memory tuning (same as sdkconfig.defaults)
CONFIG_BT_NIMBLE_ACL_BUF_COUNT=12
CONFIG_BT_NIMBLE_ACL_BUF_SIZE=255
CONFIG_BT_NIMBLE_HCI_EVT_BUF_SIZE=256
CONFIG_BT_NIMBLE_HCI_EVT_HI_BUF_COUNT=6
CONFIG_BT_NIMBLE_HCI_EVT_LO_BUF_COUNT=6
CONFIG_BT_NIMBLE_MSYS_1_BLOCK_COUNT=12
CONFIG_BT_NIMBLE_MSYS_2_BLOCK_COUNT=6
CONFIG_BT_NIMBLE_MAX_BONDS=1

# MQTT
CONFIG_MQTT_PROTOCOL_311=y

# Partition Table
CONFIG_PARTITION_TABLE_CUSTOM=y
CONFIG_PARTITION_TABLE_CUSTOM_FILENAME="partitions.csv"

# FreeRTOS
CONFIG_FREERTOS_HZ=1000

# HTTP Server
CONFIG_HTTPD_MAX_REQ_HDR_LEN=1024
CONFIG_HTTPD_MAX_URI_LEN=1024

# LWIP
CONFIG_LWIP_MAX_SOCKETS=16
CONFIG_LWIP_TCP_SND_BUF_DEFAULT=8192
CONFIG_LWIP_TCP_WND_DEFAULT=8192
CONFIG_LWIP_TCP_MSS=1460

# mbedTLS (for crypto)
CONFIG_MBEDTLS_MD_C=y
CONFIG_MBEDTLS_CCM_C=y
CONFIG_MBEDTLS_SHA256_C=y
CONFIG_MBEDTLS_HKDF_C=y
```
